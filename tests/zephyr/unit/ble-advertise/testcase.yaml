## tests/zephyr/unit/ble-advertise/testcase.yaml
```yaml
common:
  platform_allow:
    - native_sim
    - qemu_cortex_m3
  tags:
    - ble
    - crypto
    - unit

tests:
  ble.advertise.unit.mbedtls:
    extra_configs:
      - CONFIG_HUBBLE_BLE_NETWORK_MBEDTLS=y

  ble.advertise.unit.psa:
    extra_configs:
      - CONFIG_HUBBLE_BLE_NETWORK_PSA=y
```
